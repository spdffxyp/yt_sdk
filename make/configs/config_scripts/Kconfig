## make/configs/config_scripts/Kconfig
```kconfig
mainmenu "YT switch sdk configuration"

choice
	prompt "Select the OS you want to run"
	help
		(e.g. : OS_Cyg/OS_Linux/OS_FreeRTOS)
		You can modify it in menuconfig scripts when we have other depot.

	default OS_Linux

	config OS_Cyg
		bool "OS_Cyg"
		
	config OS_Linux
		bool "OS_Linux"
		
	config OS_FreeRTOS
		bool "OS_FreeRTOS"
endchoice

choice
	depends on  OS_Cyg
	prompt "Select the sdk compilation mode for cygwin"
	help
		(e.g. : Compile sdk into a library/executable file)
		You can modify it in menuconfig scripts when we have other depot.

	default SDK_CYG_EXE_WITH_CLI

	config SDK_CYG_DYN_LIB
		bool "Compile sdk into a dynamic library"
	config SDK_CYG_EXE_WITH_CLI
		select CMD_SIMPLE
		bool "Compile sdk and cli into an executable file"
endchoice

choice
	depends on  OS_Linux
	prompt "Select the sdk compilation mode for linux"
	help
		(e.g. : Compile sdk into a library/executable file/module)
		You can modify it in menuconfig scripts when we have other depot.

	default User_Mode

	config User_Mode
		bool "sdk in user space"

	config Kernel_Mode
		bool "sdk in kernel space"
endchoice

choice
	depends on User_Mode
	prompt "Select the compile format for sdk user mode"
	help
		Select sdk compile format for different scene

	default SDK_USER_MODE_STATIC_LIB

	config SDK_USER_MODE_STATIC_LIB
		bool "Compile sdk into a static library"
	config SDK_USER_MODE_DYN_LIB
		bool "Compile sdk into a dynamic library"
	config SDK_USER_MODE_EXE_WITH_CLI
		select CMD_SIMPLE
		bool "Compile sdk and cli into an executable file"
endchoice

choice
	depends on Kernel_Mode
	prompt "Select the compile format for sdk kernel mode"
	help
		Select sdk compile format for different scene

	default SDK_KERNEL_MODE_MODULE

	config SDK_KERNEL_MODE_MODULE
		bool "Compile sdk into a kernel module"
	config SDK_KERNEL_MODE_BUILTIN
		bool "Compile sdk and kernel together"
endchoice

menu "Toolchain configuration"	
	config TOOLCHAIN_PATH
		string "TOOLCHAIN_PATH"
		help
			Toolchain path

	config CROSS_COMPILE
		string "CROSS_COMPILE"
		help
			Cross compile prefix

	config CPU_ARCH
		depends on Kernel_Mode
		string "CPU_ARCH"
		help
			Architecture of cpu
			
	config LINUX_SRC_PATH
		depends on Kernel_Mode
		string "LINUX_SRC_PATH"
		help
			Define the root path of linux source code.
endmenu

choice
	prompt "SWITCH_SERIES"
	help
		Define switch chip series name. e.g.:tiger

	config Tiger
		bool "Tiger"
endchoice


choice
	prompt "Select the board hardware config"
	help
		Select the demo config or add hardware config according to your own design.

	config Board_AUTO_Detect
		bool "Board_AUTO_Detect"
	config Board_YT9215_Default_Demo
		depends on Tiger
		bool "Board_YT9215_Default_Demo"
	config Board_YT9218MB_Default_Demo
		depends on Tiger
		bool "Board_YT9218MB_Default_Demo"
	config Board_YT9218N_Default_Demo
		depends on Tiger
		bool "Board_YT9218N_Default_Demo"
	config Board_YT9214NB_Default_Demo
		depends on Tiger
		bool "Board_YT9214NB_Default_Demo"
	config Board_YT9213NB_Default_Demo
		depends on Tiger
		bool "Board_YT9213NB_Default_Demo"
	config Board_YT9215RB_Default_Demo
		depends on Tiger
		bool "Board_YT9215RB_Default_Demo"
	config Board_YT9215RB_YT8531_Demo
		depends on Tiger
		bool "Board_YT9215RB_YT8531_Demo"
	config Board_YT9215S_YT8531_Fib_Demo
		depends on Tiger
		bool "Board_YT9215S_YT8531_Fib_Demo"
	config Board_YT9215S_Fib_Demo
		depends on Tiger
		bool "Board_YT9215S_Fib_Demo"
	config Board_YT9215SC_Default_Demo
		depends on Tiger
		bool "Board_YT9215SC_Default_Demo"
	config Board_YT9218MB_YT8531_Demo
		depends on Tiger
		bool "Board_YT9218MB_YT8531_Demo"
	config Board_YT921X_MULTI_SW_Demo
		depends on Tiger
		bool "Board_YT921X_MULTI_SW_Demo"
	config Board_Customer
		bool "Board_Customer"
endchoice

config INTER_MCU
    bool "Internal MCU"
    help
        internal mcu in switch

menu "Supported phy list"
    config PHY_YT8531
        bool "YT8531"
        help
            single port phy
endmenu

choice
	prompt "Select sdk release mode"
	help
		Select sdk model for different release

	config SDK_MODEL_FULL
		bool "SDK_MODEL_FULL"
	config SDK_MODEL_CUST
		bool "SDK_MODEL_CUST"
endchoice

config YT_SDK_VERSION
	string "YT_SDK_VERSION"
	help
		used to define sdk version,
		to update the YT_SDK_VERSION in version.h

menu "Sdk module optional"
	config SWITCH_ACL_NUM
		int "switch acl num is int, range is 1-384"
		range 1 384
		default 384

    config CMD_SIMPLE
        bool "Simple cmd support"
        help
            Simple cmd line support

	choice
		depends on CMD_SIMPLE
		prompt "Select simple cmd access SDK mode"
		help
			If Simple cmd can access SDK directly, choose CMD_SMPL_ACCESS_SDK_DIRECT.
			If Simple cmd needs IOCTL to access SDK, choose CMD_SMPL_ACCESS_SDK_IOCTL.
		default CMD_SMPL_ACCESS_SDK_DIRECT

		config CMD_SMPL_ACCESS_SDK_DIRECT
			bool "Simple cmd can access SDK directly"

		config CMD_SMPL_ACCESS_SDK_IOCTL
			depends on OS_Linux && Kernel_Mode
			bool "Simple cmd needs to access SDK through IOCTL"
	endchoice

	choice
		prompt "Select switch access mode"
		help
			Select access mode for switch

		default CTRLIF

		config UART
			bool "UART"
		
		config CTRLIF
			bool "CTRLIF"
		
		config MEM
			bool "MEM"

		config SW_CTRL_IOCTL
			depends on OS_Linux && User_Mode
			bool "Access switch via ioctl"
			help
				If sdk in user space and mdio driver in kernel, select this option.
	endchoice

endmenu
```
